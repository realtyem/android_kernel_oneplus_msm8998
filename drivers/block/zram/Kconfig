## drivers/block/zram/Kconfig
```kconfig
config ZRAM
	tristate "Compressed RAM block device support"
	depends on BLOCK && SYSFS && ZSMALLOC && CRYPTO
	select CRYPTO_LZO
	default n
	help
	  Creates virtual block devices called /dev/zramX (X = 0, 1, ...).
	  Pages written to these disks are compressed and stored in memory
	  itself. These disks allow very fast I/O and compression provides
	  good amounts of memory savings.

	  It has several use cases, for example: /tmp storage, use as swap
	  disks and maybe many more.

	  See Documentation/blockdev/zram.txt for more information.

config ZRAM_WRITEBACK
       bool "Write back incompressible page to backing device"
       depends on ZRAM
       default n
       help
	 With incompressible page, there is no memory saving to keep it
	 in memory. Instead, write it out to backing device.
	 For this feature, admin should set up backing device via
	 /sys/block/zramX/backing_dev.

	 See Documentation/blockdev/zram.txt for more information.

config ZRAM_MEMORY_TRACKING
	bool "Track zRam block status"
	depends on ZRAM && DEBUG_FS
	help
	  With this feature, admin can track the state of allocated blocks
	  of zRAM. Admin could see the information via
	  /sys/kernel/debug/zram/zramX/block_state.

	  See Documentation/blockdev/zram.txt for more information.

choice
	prompt "Choose Default Zram Compressor"
	depends on ZRAM
	default DEFAULT_ZRAM_COMPRESSOR_LZO
	help
	  Choose from the available compressors to use as a compression 
	  algorithm for Zram Device.

	config DEFAULT_ZRAM_COMPRESSOR_LZO
		bool "LZO (default)" if CRYPTO_LZO=y

	config DEFAULT_ZRAM_COMPRESSOR_ZLIB
		bool "ZLIB" if CRYPTO_ZLIB=y

	config DEFAULT_ZRAM_COMPRESSOR_DEFLATE
		bool "Deflate" if CRYPTO_DEFLATE=y

	config DEFAULT_ZRAM_COMPRESSOR_LZ4
		bool "LZ4" if CRYPTO_LZ4=y

	config DEFAULT_ZRAM_COMPRESSOR_ZSTD
		bool "ZSTD" if CRYPTO_ZSTD=y

endchoice

config DEFAULT_ZRAM_COMPRESSOR
	string
	default "lzo" if DEFAULT_ZRAM_COMPRESSOR_LZO
	default "zlib" if DEFAULT_ZRAM_COMPRESSOR_ZLIB
	default "deflate" if DEFAULT_ZRAM_COMPRESSOR_DEFLATE
	default "lz4" if DEFAULT_ZRAM_COMPRESSOR_LZ4
	default "zstd" if DEFAULT_ZRAM_COMPRESSOR_ZSTD
	default "lzo"
```
